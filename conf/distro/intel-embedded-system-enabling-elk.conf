## conf/distro/intel-embedded-system-enabling-elk.conf
```bitbake
DISTRO = "intel-embedded-system-enabling-elk"
DISTRO_NAME = "meta-intel-ese Reference Distro Emergency Linux Kernel"
DISTRO_VERSION = "1.0-ESE"
DISTRO_CODENAME = "${LAYERSERIES_CORENAMES}"

LOCALCONF_VERSION = "1"

TCLIBC = "musl"
PREFERRED_PROVIDER_virtual/kernel = "linux-intel-dev-elk"

# Default features enabled in distro
DISTRO_FEATURES_DEFAULT ?= "acl ext2 largefile usbhost xattr pci"
DISTRO_FEATURES_NATIVE ?= "ipv6"
DISTRO_FEATURES_NATIVESDK ?= ""
DISTRO_FEATURES_LIBC_DEFAULT ?= "ipv4 ipv6 libc-bsd libc-crypt libc-wordexp libc-posix-regexp"

DISTRO_FEATURES ?= "${DISTRO_FEATURES_DEFAULT} ${DISTRO_FEATURES_LIBC} elk-busybox"
FULL_OPTIMIZATION = "-Os -pipe -Wno-error ${DEBUG_FLAGS}"
INITRAMFS_FSTYPES = "cpio cpio.xz"
```

## conf/distro/intel-embedded-system-enabling.conf
```bitbake
DISTRO = "intel-embedded-system-enabling"
DISTRO_NAME = "meta-intel-ese Reference Distro"
DISTRO_VERSION = "1.0-ESE"
DISTRO_CODENAME = "${LAYERSERIES_CORENAMES}"

SDK_VENDOR = "-esesdk"
SDK_VERSION := "${@'${DISTRO_VERSION}'.replace('snapshot-${DATE}','snapshot')}"

TARGET_VENDOR = "-ese"
LOCALCONF_VERSION = "1"

# Providers
PREFERRED_PROVIDER_jpeg = "libjpeg-turbo"
PREFERRED_PROVIDER_jpeg-native = "libjpeg-turbo-native"

# Default features enabled in distro
ESE_DEFAULT_DISTRO_FEATURES = "wayland opengl gles2 egl pam systemd ptest virtualization"
ESE_DEFAULT_EXTRA_RDEPENDS = "packagegroup-core-boot"

DISTRO_FEATURES_DEFAULT ?= "acl alsa argp bluetooth ext2 largefile usbgadget usbhost wifi xattr pci"
DISTRO_FEATURES_NATIVE ?= "ipv6"
DISTRO_FEATURES_NATIVESDK ?= "libc-charsets libc-locales libc-locale-code"
GTK2DISTROFEATURES ?= "directfb"
GTK3DISTROFEATURES ?= "wayland"

DISTRO_FEATURES ?= "${DISTRO_FEATURES_DEFAULT} ${DISTRO_FEATURES_LIBC} ${ESE_DEFAULT_DISTRO_FEATURES}"
DISTRO_EXTRA_RDEPENDS += "${ESE_DEFAULT_EXTRA_RDEPENDS}"

VIRTUAL-RUNTIME_init_manager = '${@bb.utils.contains("DISTRO_FEATURES", "systemd", "systemd", "sysvinit", d)}'
VIRTUAL-RUNTIME_initscripts = '${@bb.utils.contains("DISTRO_FEATURES", "systemd", "", "initscripts",d)}'
DISTRO_FEATURES_BACKFILL_CONSIDERED:append =' ${@bb.utils.contains("DISTRO_FEATURES", "systemd", "sysvinit", "", d)}'

# Inherit dm-verity class which will include dm-verity feature
# conditional upon dm-verity being included in DISTRO_FEATURES
INHERIT += "dm-verity"

# for x86-64
require ${@bb.utils.contains("TARGET_ARCH", "x86_64", "conf/include/ese-x86-all.inc", "", d)}
```

## conf/layer.conf
```bitbake
# We have a conf and classes directory, add to BBPATH
BBPATH .= ":${LAYERDIR}"

# We have recipes-* directories, add to BBFILES
BBFILES += "${LAYERDIR}/recipes-*/*/*.bb ${LAYERDIR}/recipes-*/*/*.bbappend"

BBFILE_COLLECTIONS += "meta-intel-ese"
BBFILE_PATTERN_meta-intel-ese = "^${LAYERDIR}/"
BBFILE_PRIORITY_meta-intel-ese = "7"

LAYERVERSION_meta-intel-ese = "1"
LAYERDEPENDS_meta-intel-ese = "core"
LAYERDEPENDS_meta-intel-ese = "intel"

LAYERSERIES_COMPAT_meta-intel-ese = "sumo thud warrior zeus dunfell"
```
